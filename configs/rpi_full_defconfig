## configs/rpi_full_defconfig
```kconfig
BR2_arm=y
BR2_arm1176jzf_s=y
BR2_CCACHE=y
BR2_TOOLCHAIN_EXTERNAL=y
BR2_TOOLCHAIN_EXTERNAL_CUSTOM=y
BR2_TOOLCHAIN_EXTERNAL_PATH="/opt/mmdc/rpi/arm-bcm2708hardfp-linux-gnueabi"
BR2_TOOLCHAIN_EXTERNAL_CUSTOM_PREFIX="$(ARCH)-bcm2708hardfp-linux-gnueabi"
BR2_TOOLCHAIN_EXTERNAL_CUSTOM_GLIBC=y
BR2_TOOLCHAIN_EXTERNAL_CXX=y
BR2_ENABLE_LOCALE_PURGE=y
BR2_ENABLE_LOCALE_WHITELIST="C en_US zh_TW.UTF-8"
BR2_GENERATE_LOCALE="zh_TW.UTF-8"
BR2_TARGET_OPTIMIZATION="-pipe -O2 -mfpu=vfp -mfloat-abi=hard -march=armv6zk -mtune=arm1176jzf-s"
BR2_TARGET_GENERIC_HOSTNAME="rpi"
BR2_TARGET_GENERIC_ISSUE="Welcome to RPi"
BR2_ROOTFS_DEVICE_CREATION_DYNAMIC_MDEV=y
BR2_TARGET_GENERIC_GETTY_PORT="tty1"
BR2_TARGET_GENERIC_GETTY_BAUDRATE_38400=y
BR2_PACKAGE_BUSYBOX_SHOW_OTHERS=y
BR2_PACKAGE_XZ=y
BR2_PACKAGE_LIBERATION=y
BR2_PACKAGE_NFS_UTILS=y
BR2_PACKAGE_NTFS_3G=y
BR2_PACKAGE_LINUX_FIRMWARE=y
BR2_PACKAGE_LINUX_FIRMWARE_RALINK_RT2XX=y
BR2_PACKAGE_RPI_FIRMWARE=y
BR2_PACKAGE_RPI_USERLAND=y
BR2_PACKAGE_FREETYPE=y
BR2_PACKAGE_BOOST=y
BR2_PACKAGE_PCRE=y
BR2_PACKAGE_NTP=y
# BR2_PACKAGE_NTP_NTPD is not set
BR2_PACKAGE_NTP_NTPDATE=y
BR2_PACKAGE_OPENSSH=y
BR2_PACKAGE_RSYNC=y
BR2_PACKAGE_RTORRENT=y
BR2_PACKAGE_WGET=y
BR2_PACKAGE_WIRELESS_TOOLS=y
BR2_PACKAGE_WPA_SUPPLICANT=y
BR2_PACKAGE_BASH=y
BR2_PACKAGE_SCREEN=y
BR2_PACKAGE_SUDO=y
BR2_PACKAGE_VIM=y
BR2_LINUX_KERNEL=y
BR2_LINUX_KERNEL_CUSTOM_GIT=y
BR2_LINUX_KERNEL_CUSTOM_GIT_REPO_URL="https://github.com/raspberrypi/linux"
BR2_LINUX_KERNEL_CUSTOM_GIT_VERSION="rpi-3.6.y"
BR2_LINUX_KERNEL_PATCH="board/rpi/linux-rpi-3.6.y.patch"
BR2_LINUX_KERNEL_DEFCONFIG="bcmrpi"
BR2_LINUX_KERNEL_ZIMAGE=y
```

## configs/rpi_min_defconfig
```kconfig
BR2_arm=y
BR2_arm1176jzf_s=y
BR2_CCACHE=y
BR2_TOOLCHAIN_EXTERNAL=y
BR2_TOOLCHAIN_EXTERNAL_CUSTOM=y
BR2_TOOLCHAIN_EXTERNAL_PATH="/opt/mmdc/rpi/arm-bcm2708hardfp-linux-gnueabi"
BR2_TOOLCHAIN_EXTERNAL_CUSTOM_PREFIX="$(ARCH)-bcm2708hardfp-linux-gnueabi"
BR2_TOOLCHAIN_EXTERNAL_CUSTOM_GLIBC=y
BR2_TOOLCHAIN_EXTERNAL_CXX=y
BR2_ENABLE_LOCALE_PURGE=y
BR2_ENABLE_LOCALE_WHITELIST="C en_US zh_TW.UTF-8"
BR2_GENERATE_LOCALE="zh_TW.UTF-8"
BR2_TARGET_OPTIMIZATION="-pipe -O2 -mfpu=vfp -mfloat-abi=hard -march=armv6zk -mtune=arm1176jzf-s"
BR2_TARGET_GENERIC_HOSTNAME="rpi"
BR2_TARGET_GENERIC_ISSUE="Welcome to RPi"
BR2_ROOTFS_DEVICE_CREATION_DYNAMIC_MDEV=y
BR2_TARGET_GENERIC_GETTY_PORT="tty1"
BR2_TARGET_GENERIC_GETTY_BAUDRATE_38400=y
BR2_PACKAGE_BUSYBOX_SHOW_OTHERS=y
BR2_LINUX_KERNEL=y
BR2_LINUX_KERNEL_CUSTOM_GIT=y
BR2_LINUX_KERNEL_CUSTOM_GIT_REPO_URL="https://github.com/raspberrypi/linux"
BR2_LINUX_KERNEL_CUSTOM_GIT_VERSION="rpi-3.6.y"
BR2_LINUX_KERNEL_PATCH="board/rpi/linux-rpi-3.6.y.patch"
BR2_LINUX_KERNEL_DEFCONFIG="bcmrpi"
BR2_LINUX_KERNEL_ZIMAGE=y
```

## configs/rpi_xbmc_defconfig
```kconfig
BR2_arm=y
BR2_arm1176jzf_s=y
BR2_CCACHE=y
BR2_TOOLCHAIN_EXTERNAL=y
BR2_TOOLCHAIN_EXTERNAL_CUSTOM=y
BR2_TOOLCHAIN_EXTERNAL_PATH="/opt/mmdc/rpi/arm-bcm2708hardfp-linux-gnueabi"
BR2_TOOLCHAIN_EXTERNAL_CUSTOM_PREFIX="$(ARCH)-bcm2708hardfp-linux-gnueabi"
BR2_TOOLCHAIN_EXTERNAL_CUSTOM_GLIBC=y
BR2_TOOLCHAIN_EXTERNAL_CXX=y
BR2_ENABLE_LOCALE_PURGE=y
BR2_ENABLE_LOCALE_WHITELIST="C en_US zh_TW.UTF-8"
BR2_GENERATE_LOCALE="zh_TW.UTF-8"
BR2_TARGET_OPTIMIZATION="-pipe -O2 -mfpu=vfp -mfloat-abi=hard -march=armv6zk -mtune=arm1176jzf-s"
BR2_TARGET_GENERIC_HOSTNAME="rpi"
BR2_TARGET_GENERIC_ISSUE="Welcome to RPi"
BR2_ROOTFS_DEVICE_CREATION_DYNAMIC_UDEV=y
BR2_TARGET_GENERIC_GETTY_PORT="tty1"
BR2_TARGET_GENERIC_GETTY_BAUDRATE_38400=y
BR2_PACKAGE_BUSYBOX_SHOW_OTHERS=y
BR2_PACKAGE_ALSA_UTILS=y
BR2_PACKAGE_ALSA_UTILS_APLAY=y
BR2_PACKAGE_FLAC=y
BR2_PACKAGE_WAVPACK=y
BR2_PACKAGE_XZ=y
BR2_PACKAGE_LIBERATION=y
BR2_PACKAGE_NFS_UTILS=y
BR2_PACKAGE_NFS_UTILS_RPC_LOCKD=y
BR2_PACKAGE_NFS_UTILS_RPC_RQUOTAD=y
BR2_PACKAGE_NTFS_3G=y
BR2_PACKAGE_LINUX_FIRMWARE=y
BR2_PACKAGE_LINUX_FIRMWARE_RALINK_RT2XX=y
BR2_PACKAGE_RPI_FIRMWARE=y
BR2_PACKAGE_RPI_USERLAND=y
BR2_PACKAGE_UDEV_RULES_GEN=y
BR2_PACKAGE_UDEV_ALL_EXTRAS=y
BR2_PACKAGE_USBMOUNT=y
BR2_PACKAGE_USBUTILS=y
BR2_PACKAGE_USBUTILS_ZLIB=y
BR2_PACKAGE_PYTHON=y
BR2_PACKAGE_PYTHON_BZIP2=y
BR2_PACKAGE_PYTHON_BSDDB=y
BR2_PACKAGE_PYTHON_CODECSCJK=y
BR2_PACKAGE_PYTHON_CURSES=y
BR2_PACKAGE_PYTHON_PYEXPAT=y
BR2_PACKAGE_PYTHON_READLINE=y
BR2_PACKAGE_PYTHON_SSL=y
BR2_PACKAGE_PYTHON_SQLITE=y
BR2_PACKAGE_PYTHON_ZLIB=y
BR2_PACKAGE_LIBMAD=y
BR2_PACKAGE_LIBSAMPLERATE=y
BR2_PACKAGE_LZO=y
BR2_PACKAGE_LIBGCRYPT=y
BR2_PACKAGE_MYSQL_CLIENT=y
BR2_PACKAGE_FONTCONFIG=y
BR2_PACKAGE_LIBPNG=y
BR2_PACKAGE_LIBUNGIF=y
BR2_PACKAGE_TIFF=y
BR2_PACKAGE_LIBUSB_COMPAT=y
BR2_PACKAGE_LIBMPEG2=y
BR2_PACKAGE_LIBTHEORA=y
BR2_PACKAGE_LIBMICROHTTPD=y
BR2_PACKAGE_BOOST=y
BR2_PACKAGE_BOOST_THREAD=y
BR2_PACKAGE_PCRE=y
BR2_PACKAGE_LIBXML2=y
BR2_PACKAGE_YAJL=y
BR2_PACKAGE_AVAHI=y
BR2_PACKAGE_AVAHI_DAEMON=y
BR2_PACKAGE_NTP=y
# BR2_PACKAGE_NTP_NTPD is not set
BR2_PACKAGE_NTP_NTPDATE=y
BR2_PACKAGE_OPENSSH=y
BR2_PACKAGE_PORTMAP=y
BR2_PACKAGE_RSYNC=y
BR2_PACKAGE_RTORRENT=y
BR2_PACKAGE_SAMBA=y
# BR2_PACKAGE_SAMBA_SWAT is not set
BR2_PACKAGE_SAMBA_LIBSMBCLIENT=y
BR2_PACKAGE_WGET=y
BR2_PACKAGE_WIRELESS_TOOLS=y
BR2_PACKAGE_WPA_SUPPLICANT=y
BR2_PACKAGE_BASH=y
BR2_PACKAGE_SCREEN=y
BR2_PACKAGE_SUDO=y
BR2_PACKAGE_KMOD_TOOLS=y
BR2_PACKAGE_MODULE_INIT_TOOLS=y
BR2_PACKAGE_UTIL_LINUX_AGETTY=y
BR2_PACKAGE_VIM=y
BR2_PACKAGE_AFPFS_NG=y
BR2_PACKAGE_FRIBIDI=y
BR2_PACKAGE_JASPER=y
BR2_PACKAGE_LIBASS=y
BR2_PACKAGE_LIBBLURAY=y
BR2_PACKAGE_LIBCDIO=y
BR2_PACKAGE_LIBMODPLUG=y
BR2_PACKAGE_LIBNFS=y
BR2_PACKAGE_LIBCEC=y
# BR2_PACKAGE_LIBCEC_RBP is not set
BR2_PACKAGE_LIBPLIST=y
BR2_PACKAGE_LIBRTMP=y
BR2_PACKAGE_LIBSHAIRPORT=y
BR2_PACKAGE_LIBSSH2=y
BR2_PACKAGE_TINYXML=y
BR2_PACKAGE_TAGLIB18=y
BR2_PACKAGE_LIBSSH=y
BR2_LINUX_KERNEL=y
BR2_LINUX_KERNEL_CUSTOM_GIT=y
BR2_LINUX_KERNEL_CUSTOM_GIT_REPO_URL="https://github.com/raspberrypi/linux"
BR2_LINUX_KERNEL_CUSTOM_GIT_VERSION="rpi-3.6.y"
BR2_LINUX_KERNEL_PATCH="board/rpi/linux-rpi-3.6.y.patch"
BR2_LINUX_KERNEL_DEFCONFIG="bcmrpi"
BR2_LINUX_KERNEL_ZIMAGE=y
```

## package/tmux/Config.in
```kconfig
config BR2_PACKAGE_TMUX
	bool "tmux"
	select BR2_PACKAGE_NCURSES
        select BR2_PACKAGE_LIBEVENT
	help
          http://tmux.sourceforge.net/
```
